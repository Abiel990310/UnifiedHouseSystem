## ruview/firmware/main/Kconfig.projbuild
```kconfig
menu "RuView Node Configuration"

    config RUVIEW_NODE_ID
        string "Node ID"
        default "node_1"
        help
            Unique identifier for this sensor node (node_1, node_2, node_3).

    config RUVIEW_WIFI_SSID
        string "WiFi SSID"
        default "蝦家"
        help
            SSID of the WiFi network to connect to.

    config RUVIEW_WIFI_PASSWORD
        string "WiFi Password"
        default ""
        help
            Password for the WiFi network.

    config RUVIEW_MQTT_BROKER_IP
        string "MQTT Broker IP"
        default "192.168.1.100"
        help
            IP address of the Raspberry Pi running the MQTT broker.

    config RUVIEW_MQTT_BROKER_PORT
        int "MQTT Broker Port"
        default 1883
        help
            MQTT broker port (default 1883, or 8883 for TLS).

    config RUVIEW_CSI_PUBLISH_RATE_HZ
        int "CSI publish rate (Hz)"
        default 10
        range 1 20
        help
            How many CSI feature vectors to publish per second per node.

    config RUVIEW_WIFI_CHANNEL
        int "WiFi Channel to monitor"
        default 0
        range 0 13
        help
            Fixed WiFi channel for CSI capture. 0 = follow connected AP channel.

    config RUVIEW_OTA_SERVER_URL
        string "OTA firmware server URL"
        default "http://192.168.1.100:8080/api/v1/ota/firmware.bin"
        help
            URL to check for OTA firmware updates.

endmenu
```

## ruview/firmware/sdkconfig.defaults
```kconfig
# RuView Node — ESP32-S3 SDK defaults
# These get merged into sdkconfig on first `idf.py build`

# Target
CONFIG_IDF_TARGET="esp32s3"

# WiFi
CONFIG_ESP32S3_DEFAULT_CPU_FREQ_240=y
CONFIG_ESP_WIFI_STATIC_RX_BUFFER_NUM=16
CONFIG_ESP_WIFI_DYNAMIC_RX_BUFFER_NUM=32
CONFIG_ESP_WIFI_TX_BUFFER_TYPE_STATIC=y
CONFIG_ESP_WIFI_STATIC_TX_BUFFER_NUM=8
CONFIG_ESP_WIFI_AMPDU_TX_ENABLED=y
CONFIG_ESP_WIFI_AMPDU_RX_ENABLED=y

# CSI / Sniffer support
CONFIG_ESP_WIFI_ENABLE_WIFI_RX_STATS=y
CONFIG_ESP_WIFI_ENABLE_WIFI_TX_STATS=y

# MQTT
CONFIG_MQTT_BUFFER_SIZE=4096
CONFIG_MQTT_OUTBOX_EXPIRED_TIMEOUT_MS=30000

# FreeRTOS
CONFIG_FREERTOS_HZ=1000
CONFIG_FREERTOS_UNICORE=n

# Log level (change to VERBOSE for debugging CSI)
CONFIG_LOG_DEFAULT_LEVEL_INFO=y

# OTA
CONFIG_BOOTLOADER_APP_ROLLBACK_ENABLE=y
CONFIG_APP_UPDATE_GENERATE_ROLLBACK_HASH=y

# NVS encryption off (enable in production with secure boot)
CONFIG_NVS_ENCRYPTION=n

# Flash size — DevKitC-1 N8R8 has 8MB
CONFIG_ESPTOOLPY_FLASHSIZE_8MB=y
CONFIG_PARTITION_TABLE_CUSTOM=y
CONFIG_PARTITION_TABLE_CUSTOM_FILENAME="partitions.csv"
```
